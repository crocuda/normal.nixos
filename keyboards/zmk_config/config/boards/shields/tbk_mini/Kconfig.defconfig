## keyboards/zmk_config/config/boards/shields/tbk_mini/Kconfig.defconfig
```kconfig
if SHIELD_TBK_MINI_LEFT
 
config ZMK_KEYBOARD_NAME
    default "TBK Mini Fire"
 
config ZMK_SPLIT_ROLE_CENTRAL
    default y
 
endif
 
if SHIELD_TBK_MINI_LEFT || SHIELD_TBK_MINI_RIGHT
 
config ZMK_SPLIT
    default y
 
endif
```
